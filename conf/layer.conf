## conf/layer.conf
```bitbake
LAYERDEPENDS = "core yocto yoctobsp openembedded-layer meta-python meta-renesas"

# We have a conf and classes directory, add to BBPATH
BBPATH .= ":${LAYERDIR}"

# We have recipes-* directories, add to BBFILES
BBFILES += "${LAYERDIR}/recipes-*/*/*.bb \
			${LAYERDIR}/recipes-*/*.bb \
			${LAYERDIR}/recipes-*/*.bbappend \
            ${LAYERDIR}/recipes-*/*/*.bbappend \
            ${LAYERDIR}/recipes-*/*/*/*.bb \
            ${LAYERDIR}/recipes-*/*/*/*.bbappend \
		"

# We only include the recipes-qt if we are having the QT_LAYER in bbconfig layer.
QTDIR = "${LAYERDIR}/dynamic-layers/qt5-layer"
BBFILES += "${@'${QTDIR}/*/*.bb ${QTDIR}/*/*.bbappend' if ('${QT_LAYER}' == 'True') else ' '}"
BBMASK_append = " qtwebengine "

BBFILE_COLLECTIONS += "meta-vkrz"
BBFILE_PATTERN_meta-vkrz = "^${LAYERDIR}/"
BBFILE_PRIORITY_meta-vkrz = "16"

LAYERDEPENDS_meta-vkrz = "core"
LAYERSERIES_COMPAT_meta-vkrz = "dunfell"
LAYERSERIES_COMPAT_rz-features="dunfell"

HOSTTOOLS += "xz"
```

## conf/machine/vkrzg2l.conf
```bitbake
#@TYPE: Machine
#@NAME: Vekatech VKRZG2L machine
#@SOC:  RZ/G2L
#@DESCRIPTION: RZ/G2L platform

OVERRIDES_append = ":vkrzg2l"
SOC_FAMILY = "r9a07g044l"
require conf/machine/include/rzg2l-common.inc
require conf/machine/include/cip-core.inc

DEFAULTTUNE ?= "cortexa55"

TUNE_CONF ?= "conf/machine/include/tune-cortexa55.inc"
require ${TUNE_CONF}

UBOOT_CONFIG ??= "vkrzg2l"
UBOOT_CONFIG[vkrzg2l] = "vkrzg2l_defconfig"

# flash writer
EXTRA_IMAGEDEPENDS += " flash-writer"

PREFERRED_PROVIDER_virtual/kernel="linux-renesas"

# Support board with PMIC. Default:yes.
# With this option enabled, build both bin files for PMIC board and Concrete board.
#PMIC_SUPPORT ?= "1"

# Supported devicetree
KERNEL_DEVICETREE = " renesas/vkrzg2l.dtb"

KERNEL_DEVICETREE_OVERLAY  = " \
	renesas/overlays/vkrz-hdmi.dtbo \
	renesas/overlays/vkrz-mipi_av_disp2.dtbo \
	renesas/overlays/vkrz-mipi_vklcd07.dtbo \
	renesas/overlays/vkrz-imx219.dtbo \
"
# generate wic image
IMAGE_FSTYPES_append = " wic wic.bz2"
WKS_FILE = "sdimage-vkrzg2l.wks"
IMAGE_BOOT_FILES = " Image vkrzg2l.dtb"

# Deploy the uEnv.txt to the /boot directory
WKS_FILE_DEPENDS_append = " uenv"
IMAGE_BOOT_FILES += "uEnv.txt"
IMAGE_BOOT_FILES += "readme.txt"

# Support DTB Overlay files
IMAGE_BOOT_FILES += " overlays/*;overlays/"
#IMAGE_BOOT_FILES += " cm33/*;cm33/"

# Ship kernel modules
MACHINE_ESSENTIAL_EXTRA_RRECOMMENDS_append = " kernel-modules"
```

## conf/machine/vkrzg2lc.conf
```bitbake
#@TYPE: Machine
#@NAME: Vekatech VKRZG2LC machine
#@SOC:  RZ/G2LC
#@DESCRIPTION: RZ/G2LC platform

OVERRIDES_append = ":vkrzg2lc"
SOC_FAMILY = "r9a07g044c"
require conf/machine/include/rzg2l-common.inc
require conf/machine/include/cip-core.inc

DEFAULTTUNE ?= "cortexa55"

TUNE_CONF ?= "conf/machine/include/tune-cortexa55.inc"
require ${TUNE_CONF}

UBOOT_CONFIG ??= "vkrzg2lc"
UBOOT_CONFIG[vkrzg2lc] = "vkrzg2lc_defconfig"

# flash writer
EXTRA_IMAGEDEPENDS += " flash-writer"

PREFERRED_PROVIDER_virtual/kernel="linux-renesas"

# Support board with PMIC. Default:yes.
# With this option enabled, build both bin files for PMIC board and Concrete board.
#PMIC_SUPPORT ?= "1"

# Supported devicetree
KERNEL_DEVICETREE = " renesas/vkrzg2lc.dtb"

KERNEL_DEVICETREE_OVERLAY  = " \
	renesas/overlays/vkrz-mipi_av_disp2.dtbo \
	renesas/overlays/vkrz-mipi_vklcd07.dtbo \
	renesas/overlays/vkrz-imx219.dtbo \
"
# generate wic image
IMAGE_FSTYPES_append = " wic wic.bz2"
WKS_FILE = "sdimage-vkrzg2lc.wks"
IMAGE_BOOT_FILES = " Image vkrzg2lc.dtb"

# Deploy the uEnv.txt to the /boot directory
WKS_FILE_DEPENDS_append = " uenv"
IMAGE_BOOT_FILES += "uEnv.txt"
IMAGE_BOOT_FILES += "readme.txt"

# Support DTB Overlay files
IMAGE_BOOT_FILES += " overlays/*;overlays/"
#IMAGE_BOOT_FILES += " cm33/*;cm33/"

# Ship kernel modules
MACHINE_ESSENTIAL_EXTRA_RRECOMMENDS_append = " kernel-modules"
```

## conf/machine/vkrzv2l.conf
```bitbake
#@TYPE: Machine
#@NAME: Vekatech VKRZV2L machine
#@SOC:  RZ/V2L
#@DESCRIPTION: RZ/V2L SMARC platform

OVERRIDES_append = ":vkrzv2l"
SOC_FAMILY = "r9a07g054l"
require conf/machine/include/rzv2l-common.inc
require conf/machine/include/cip-core.inc

DEFAULTTUNE ?= "cortexa55"

TUNE_CONF ?= "conf/machine/include/tune-cortexa55.inc"
require ${TUNE_CONF}

UBOOT_CONFIG ??= "vkrzv2l"
UBOOT_CONFIG[vkrzv2l] = "vkrzv2l_defconfig"

# flash writer
EXTRA_IMAGEDEPENDS += " flash-writer"

PREFERRED_PROVIDER_virtual/kernel="linux-renesas"

# Support board with PMIC. Default:yes.
# With this option enabled, build both bin files for PMIC board and Concrete board.
#PMIC_SUPPORT ?= "1"

# Supported devicetree
KERNEL_DEVICETREE = " renesas/vkrzv2l.dtb"

KERNEL_DEVICETREE_OVERLAY  = " \
	renesas/overlays/vkrzv2l-hdmi.dtbo \
	renesas/overlays/vkrzv2l-mipi.dtbo \
	renesas/overlays/vkrzv2l-imx219.dtbo \
"
# generate wic image
IMAGE_FSTYPES_append = " wic wic.bz2"
WKS_FILE = "sdimage-vkrzv2l.wks"
IMAGE_BOOT_FILES = " Image vkrzv2l.dtb"

# Deploy the uEnv.txt to the /boot directory
WKS_FILE_DEPENDS_append = " uenv"
IMAGE_BOOT_FILES += "uEnv.txt"
IMAGE_BOOT_FILES += "readme.txt"

# Support DTB Overlay files
IMAGE_BOOT_FILES += " overlays/*;overlays/"
#IMAGE_BOOT_FILES += " cm33/*;cm33/"

# Ship kernel modules
MACHINE_ESSENTIAL_EXTRA_RRECOMMENDS_append = " kernel-modules"
```
